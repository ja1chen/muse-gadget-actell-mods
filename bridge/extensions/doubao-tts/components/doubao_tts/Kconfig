## bridge/extensions/doubao-tts/components/doubao_tts/Kconfig
```kconfig
menu "Doubao reply speech"
config DOUBAO_TTS
    bool
    depends on MUSE_HATCH && MUSE_ENABLED
    default y if DOUBAO_TTS_API_KEY != ""
    default n
    help
        Sends completed voice-turn reply text to Doubao over verified HTTPS.
        Console text turns remain text only. PCM16 mono at 16 kHz.
config DOUBAO_TTS_API_KEY
    string "Doubao API key (private build input)"
    depends on MUSE_HATCH && MUSE_ENABLED
    default ""
endmenu
```

## bridge/extensions/gadget-actell/components/actell_bridge/Kconfig
```kconfig
menu "Independent Actell companion"
config ACTELL_BRIDGE
    bool "Enable independent LAN Actell command bridge"
    default n
    help
        Uses Wi-Fi HTTPS directly, never Home Link tunnel. Requires trusted OOB
        credentials, valid clock and Actell per-device authorization. No listener.
config ACTELL_BRIDGE_IMAGES
    bool "Enable experimental small JPEG command results"
    depends on ACTELL_BRIDGE && SPIRAM
    default n
    help
        Returns official camera.capture wire format. Actual Muse model image
        visibility must be verified before coordinate planning. Maximum 256 KiB.
config ACTELL_BRIDGE_AVATAR_ACTIVITY
    bool "Optional verified read/write activity on the existing avatar"
    depends on ACTELL_BRIDGE && MUSE_ENABLED
    default n
    help
        Uses the separately staged approved avatar's nonblocking setters only
        for verified running/succeeded calls. No effect if that renderer is absent.
config ACTELL_BRIDGE_USB_SETUP
    bool "Physical-button trusted USB development setup"
    depends on ACTELL_BRIDGE && SOC_USB_SERIAL_JTAG_SUPPORTED
    default n
    help
        Requires a verified active-low GPIO held for two seconds during the
        first eight seconds after normal app startup (release boot straps at reset).
        Opens native USB provisioning for 120 seconds before normal startup.
        Never exposes secrets to LAN. Disabled by default.
config ACTELL_SETUP_BUTTON_GPIO
    int "Verified active-low setup button GPIO (-1 disables)"
    depends on ACTELL_BRIDGE_USB_SETUP
    range -1 48
    default -1
endmenu
```

## bridge/extensions/muse-fonts/Kconfig
```kconfig
menu "Actell shared resources"
    config ACTELL_CAPTION_FONT
        bool "Read caption font from shared read-only resources"
        depends on MUSE_ENABLED && MUSE_BOARD_WAVESHARE_S3_216
        default n
        help
            Experimental 480x480 profile. Validate the ACTRES01 resource package
            and decode one glyph at a time from immutable Flash. Missing or
            incompatible resources use the original font and pagination.
            Does not write Flash, update partitions, or change account data.
endmenu
```

## mods/extensions/doubao-tts/components/doubao_tts/Kconfig
```kconfig
menu "Doubao reply speech"
config DOUBAO_TTS
    bool
    depends on MUSE_HATCH && MUSE_ENABLED
    default y if DOUBAO_TTS_API_KEY != ""
    default n
    help
        Sends completed voice-turn reply text to Doubao over verified TLS.
        Console text turns remain text only. PCM16 mono at 16 kHz.
config DOUBAO_TTS_API_KEY
    string "Doubao API key (private build input)"
    depends on MUSE_HATCH && MUSE_ENABLED
    default ""
config DOUBAO_TTS_BIDIRECTIONAL
    bool "Use bidirectional WebSocket TTS (otherwise HTTP streaming)"
    depends on DOUBAO_TTS
    default y
    select WS_TRANSPORT
    select WS_DYNAMIC_BUFFER
    help
        Select the transport at compile time. Enabled: bidirectional WebSocket;
        disabled: the existing HTTP unidirectional implementation. No runtime
        fallback or automatic replay between transports. No extra secret fields.
config WS_BUFFER_SIZE
    default 4096 if DOUBAO_TTS_BIDIRECTIONAL
    range 4096 65536 if DOUBAO_TTS_BIDIRECTIONAL
    help
        Doubao's upgrade response headers can exceed the IDF 1 KiB default.
        Bidirectional mode requires at least 4 KiB; explicit larger buffers
        remain supported. Dynamic transport buffers are freed after the
        upgrade's buffered data is consumed.
endmenu
```
